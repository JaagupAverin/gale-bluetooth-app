## west.yml
```yaml
manifest:
  version: "1.2"

  self:
    path: hmi_app

  remotes:
    - name: origin
      url-base: https://github.com/JaagupAverin

  projects:
    - name: gale-shared
      path: shared
      remote: origin
      revision: main
      import: true
```
